# include "crosses_left.dtsi"

/* &trackball_peripheral_split { */
/*   device = <&trackball_peripheral>; */
/*   scroller { */
/*     input-processors = */
/*       <&zip_xy_to_scroll_mapper>, */
/*       <&zip_omit_x_scaler 0 1>, */
/*       <&zip_ble_report_rate_limit>; */
/*   }; */
/* }; */
